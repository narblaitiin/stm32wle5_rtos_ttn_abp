## CMakeLists.txt
```
cmake_minimum_required(VERSION 3.20.0)

find_package(Zephyr REQUIRED HINTS $ENV{ZEPHYR_BASE})
project(stm32wle5_rtos_ttn_abp)

FILE(GLOB app_sources src/*.c)
target_sources(app PRIVATE ${app_sources})
```

## prj.conf
```kconfig
# Debugger Support
CONFIG_CONSOLE=y
CONFIG_UART_CONSOLE=y

# Communication Bus Support
CONFIG_GPIO=y
CONFIG_SPI=y

# LoRa Support
CONFIG_LORA=y

# LoRaWAN Support
CONFIG_LORAWAN=y
CONFIG_HAS_SEMTECH_LORAMAC=y
CONFIG_LORAMAC_REGION_EU868=y

# Stack Support
CONFIG_MAIN_STACK_SIZE=2048
CONFIG_SYSTEM_WORKQUEUE_STACK_SIZE=2048

# Random Number Generation Support
CONFIG_TEST_RANDOM_GENERATOR=y
```

## src/main.c
```c
/*
 * Copyright (c) 2024
 * Regis Rousseau
 * Univ Lyon, INSA Lyon, Inria, CITI, EA3720
 * SPDX-License-Identifier: Apache-2.0
 */

#include "app_lorawan.h"

//  ======== globals ============================================
static const struct gpio_dt_spec led_tx = GPIO_DT_SPEC_GET(LED_TX, gpios);
static const struct gpio_dt_spec led_rx = GPIO_DT_SPEC_GET(LED_RX, gpios);

struct values {
	int16_t vbat;
	int16_t temp;
	int16_t hum;
	int16_t vadc;
};

//  ======== main ===============================================
int8_t main(void)
{
	const struct device *dev;
	struct values data;
	uint8_t payload[9];
    int8_t ret;

	// configuration of LEDs
	gpio_pin_configure_dt(&led_tx, GPIO_OUTPUT_ACTIVE);
	gpio_pin_configure_dt(&led_rx, GPIO_OUTPUT_ACTIVE);
	gpio_pin_set_dt(&led_tx, 0);
	gpio_pin_set_dt(&led_rx, 0);

	// initialization of LoRaWAN - TTN
	app_lorawan_init(dev);

	printk("Geophone Measurement Simulation and Process Information - Board: %s\n", CONFIG_BOARD);
	
	// beginning forever loop (polling mode)
	while (1) {
		// constrution of random data structure
		data.vbat = sys_rand16_get() % (3300 - 0 + 1) + 0;
		data.temp = -15 + sys_rand16_get() % (50 - 25 +1);
		data.hum = sys_rand16_get() % (100 - 0 + 1) + 0;
		data.vadc = sys_rand16_get() % (3300 - 0 + 1) + 0;
		printk("vbat: %"PRId16", temp: %"PRId16", hum: %"PRId16", vadc: %"PRId16"\n", data.vbat, data.temp, data.hum, data.vadc);
		
		// transmission of packets on lorawan protocole - encode payload to bytes
		// battery needs 2 bytes
		payload[0] = (data.vbat >> 8) & 0xFF;
        payload[1] = data.vbat & 0xFF;

		// temperature needs 3 byte 327.67 max value (signed short)
		if (data.temp < 0) {
			payload[2] = 1 & 0xff;
		} else {
			payload[2] = 1 & 0xff;
		}
		payload[3] = (data.temp >> 8) & 0xFF;
        payload[4] = data.temp & 0xFF;

		// humidity needs 2 bytes
		payload[5] = (data.hum >> 8) & 0xFF;
        payload[6] = data.hum & 0xFF;

		// adc needs 2 bytes
		payload[7] = (data.vadc >> 8) & 0xFF;
        payload[8] = data.vadc & 0xFF;

		printk("sending random data...\n");
		gpio_pin_set_dt(&led_tx, 1);
		ret = lorawan_send(LORAWAN_PORT, payload, sizeof(payload), LORAWAN_MSG_CONFIRMED);
		if (ret == -EAGAIN) {
			printk("lorawan_send failed: %d. continuing...\n", ret);
			k_sleep(DELAY);
			continue;
		}
		
		if (ret < 0) {
			printk("lorawan_send failed: %d.\n", ret);
			//return 0;
			k_sleep(DELAY);
			continue;
		} else {
			// flashing of the LED when a packet is transmitted
			gpio_pin_set_dt(&led_tx, 0);
			printk("data sent!\n"); 
			k_sleep(DELAY);
		}
	}
	return 0;
}
```

## src/app_lorawan.c
```c
/*
 * Copyright (c) 2024
 * Regis Rousseau
 * Univ Lyon, INSA Lyon, Inria, CITI, EA3720
 * SPDX-License-Identifier: Apache-2.0
 */

#include "app_lorawan.h"

//  ======== globals ============================================
static const struct gpio_dt_spec led_tx = GPIO_DT_SPEC_GET(LED_TX, gpios);
static const struct gpio_dt_spec led_rx = GPIO_DT_SPEC_GET(LED_RX, gpios);

// downlink callback
static void dl_callback(uint8_t port, bool data_pending, int16_t rssi, int8_t snr, uint8_t len, const uint8_t *data)
{
	printk("downlink data received: ");
    for(int8_t i=0; i < len; i++) {
		printk("%02X ", data[i]);
	}
    printk("\n");
	printk("port: %d, pending: %d, RSSI: %ddB, SNR: %dBm\n", port, data_pending, rssi, snr);
}

// ADR change callback
static void lorwan_datarate_changed(enum lorawan_datarate dr)
{
	uint8_t unused, max_size;

	lorawan_get_payload_sizes(&unused, &max_size);
	printk("new datarate: DR_%d, max 	`payload: %d\n", dr, max_size);
}

//  ======== app_loarwan_init ===================================
int8_t app_lorawan_init(const struct device *dev)
{
	struct lorawan_join_config join_cfg;

    int8_t ret;
    uint8_t dev_addr[] = LORAWAN_DEV_ADDR;
	uint8_t app_skey[] = LORAWAN_APP_SKEY;
    uint8_t nwk_skey[] = LORAWAN_NWK_SKEY;
	uint8_t app_eui[]  = LORAWAN_DEV_EUI;

	char lorawan_dev_addr[4 * 2 + 1] = "";
	char lorawan_app_skey[16 * 2 + 1] = "";
	char lorawan_nwk_skey[16 * 2 + 1] = "";
	char lorawan_app_eui[16 * 2 + 1] = "";

	printk("starting lorawan node\n");
    // getting lora sx1276 device
	dev = DEVICE_DT_GET(DT_ALIAS(lora0));
	if (!device_is_ready(dev)) {
		printk("%s: device not ready\n", dev->name);
		return 0;
	}

	printk("starting lorawan stack\n");
    // starting device
	ret = lorawan_set_region(LORAWAN_REGION_EU868);
	if (ret < 0) {
		printk("lorawan_set_region failed: %d\n", ret);
		return 0;
	}

	ret = lorawan_start();
	if (ret < 0) {
		printk("lorawan_start failed. error: %d\n", ret);
		return 0;
	} else {
		k_sleep(K_MSEC(500));
	}
	gpio_pin_set_dt(&led_rx, 0);

	// enable ADR
    lorawan_enable_adr(true);

    // enable callbacks
	struct lorawan_downlink_cb downlink_cb = {
		.port = LW_RECV_PORT_ANY,
		.cb = dl_callback
	};
	lorawan_register_downlink_callback(&downlink_cb);
	lorawan_register_dr_changed_callback(lorwan_datarate_changed);  

	hex2bin(lorawan_app_skey, strlen(lorawan_app_skey), app_skey, sizeof(app_skey));
    hex2bin(lorawan_nwk_skey, strlen(lorawan_nwk_skey), nwk_skey, sizeof(nwk_skey));
	hex2bin(lorawan_app_eui, strlen(lorawan_app_eui), nwk_skey, sizeof(app_eui));
    hex2bin(lorawan_dev_addr, strlen(lorawan_dev_addr), (uint8_t *)&dev_addr, sizeof(dev_addr));

	// configuration of lorawan parameters 
    join_cfg.mode = LORAWAN_ACT_ABP;
    join_cfg.abp.dev_addr = dev_addr;
    join_cfg.abp.app_skey = app_skey;
    join_cfg.abp.nwk_skey = nwk_skey;
	join_cfg.abp.app_eui = app_eui;

	printk("joining TTN network over ABP\n");
	do {
		gpio_pin_set_dt(&led_rx, 1);
		
		ret = lorawan_join(&join_cfg);
		if (ret < 0) {
	    	printk("lorawan join network failed. error: %d\n", ret);
			printk("sleeping for 10s to try again to join network.\n");
			gpio_pin_set_dt(&led_rx, 0);
			k_sleep(K_MSEC(10000));
		}
		gpio_pin_set_dt(&led_rx, 1);
	} while (ret < 0);



	printk("setting device to class A\n");
	ret = lorawan_set_class(LORAWAN_CLASS_A);
	if (ret != 0) {
		printk("failed to set LoRaWAN class. error: %d", ret);
	}
	gpio_pin_set_dt(&led_rx, 0);
    return 0;
}



  
    
```

## src/app_lorawan.h
```c
/*
 * Copyright (c) 2024
 * Regis Rousseau
 * Univ Lyon, INSA Lyon, Inria, CITI, EA3720
 * SPDX-License-Identifier: Apache-2.0
 */

#ifndef APP_LORAWAN__H
#define APP_LORAWAN__H

//  ======== includes =============================================
#include <zephyr/device.h>
#include <zephyr/kernel.h>
#include <zephyr/drivers/gpio.h>
#include <zephyr/drivers/lora.h>
#include <zephyr/lorawan/lorawan.h>
#include <zephyr/random/random.h>

//  ======== defines ==============================================
/* led control */
#define LED_TX                  DT_ALIAS(ledtx)      // declared in device tree 
#define LED_RX                  DT_ALIAS(ledrx)      // declared in device tree
#define DELAY 			        K_MSEC(30000)
//#define DELAY 			        K_MINUTES(1)

/* customize based on network configuration */
#define LORAWAN_DEV_ADDR		"260B15AF"  //{ 0x26, 0x0B, 0x15, 0xAF }
#define LORAWAN_DEV_EUI			{ 0x70, 0xB3, 0xD5, 0x7E, 0xD0, 0x06, 0xD8, 0xDE }
#define LORAWAN_NWK_SKEY        { 0x7D, 0x04, 0x12, 0x67, 0x7E, 0xD4, 0xCC, 0x1B, 0xF5, 0xB3, 0xE7, 0xFC, 0xF1, 0xB9, 0xE5, 0xA2 }
#define LORAWAN_APP_SKEY		{ 0xE9, 0x4B, 0xCA, 0x98, 0x22, 0x78, 0x62, 0x1D, 0x26, 0xCA, 0xDF, 0x7D, 0x6D, 0xF4, 0x56, 0x23 }
#define LORAWAN_PORT            2

//  ======== prototypes ============================================
int8_t app_lorawan_init(const struct device *dev);

#endif /* APP_LORAWAN__H */
```
